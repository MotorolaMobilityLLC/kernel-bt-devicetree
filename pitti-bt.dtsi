#include <dt-bindings/interconnect/qcom,pitti.h>

&soc {
        bluetooth: wcn3990 {
                compatible = "qcom,wcn3990";
                qcom,bt-sw-ctrl-gpio = <&tlmm 111 0>;
                qcom,bt-vdd-io-supply = <&L9A>;   /* IO */
                qcom,bt-vdd-core-supply = <&S6A>; /* RFA */
                qcom,bt-vdd-pa-supply = <&L23A>;   /* CH0 */
                qcom,bt-vdd-xtal-supply = <&L12A>;/* XO */

                qcom,bt-vdd-io-config = <1700000 2000000 1 0>;
                qcom,bt-vdd-core-config = <1304000 1374000 1 0>;
                qcom,bt-vdd-pa-config = <3000000 3544000 1 0>;
                qcom,bt-vdd-xtal-config = <1700000 2000000 1 0>;
        };
};

//uart instance
&qupv3_se2_4uart {
        status = "ok";
};


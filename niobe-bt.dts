/dts-v1/;
/plugin/;

#include "niobe-bt.dtsi"
/ {
        model = "Qualcomm Technologies, Inc. Niobe";
        compatible = "qcom,niobe";
        qcom,msm-id = <629 0x10000>;
        qcom,board-id = <0x10021 0>, <0x10022 0>;
};

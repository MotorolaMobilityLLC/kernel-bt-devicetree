// SPDX-License-Identifier: BSD-3-Clause
/*
 * Copyright (c) Qualcomm Technologies, Inc. and/or its subsidiaries.
 */

/dts-v1/;
/plugin/;

#include "alor-peach-bt.dtsi"
#include "alor-peach-bt-vantage.dtsi"

#define VANTAGE_RADIO_JAPAN 3

/ {
	model = "vantage";
	compatible = "qcom,alor-atp", "qcom,alor", "qcom,atp", "qcom,alor-mtp", "qcom,mtp",
		     "qcom,alor-rcm", "qcom,rcm", "qcom,alor-qrd", "qcom,qrd";
	qcom,msm-id = <685 0x10000>;
	qcom,board-id = <0x41 0xB1B0>, <0x41 0xC000>, <(VANTAGE_RADIO_JAPAN <<8 | 0x41) 0xA100>;
};

/dts-v1/;
/plugin/;
// This file is copied from: cliffs-kiwi-bt-arcfox-evt3.dts
#include "cliffs-kiwi-bt-arcfox.dtsi"

/ {
	model = "eiger";
	compatible = "qcom,cliffs";
	qcom,msm-id = <614 0x10000>, <632 0x10000>;
	qcom,board-id = <0x46 0xA000>;
};
